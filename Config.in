## Config.in
```kconfig
# Add project-specific packages for Buildroot here
#
# If these are non-proprietary, please consider contributing them back to
# Nerves or Buildroot.
#
source "$NERVES_DEFCONFIG_DIR/package/python-cap1xxx/Config.in"
source "$NERVES_DEFCONFIG_DIR/package/python-dot3k/Config.in"
source "$NERVES_DEFCONFIG_DIR/package/python-sn3218/Config.in"
source "$NERVES_DEFCONFIG_DIR/package/python-st7036/Config.in"
```

## package/python-cap1xxx/Config.in
```kconfig
config BR2_PACKAGE_PYTHON_CAP1XXX
	bool "python-cap1xxx"
	select BR2_PACKAGE_PYTHON_RPIGPIO # runtime
	help
	  A module to drive various Microchip cap1xxx touch ICs.

	  http://shop.pimoroni.com
```

## package/python-dot3k/Config.in
```kconfig
config BR2_PACKAGE_PYTHON_DOT3K
	bool "python-dot3k"
	select BR2_PACKAGE_PYTHON_ST7036 # runtime
	select BR2_PACKAGE_PYTHON_SN3218 # runtime
	select BR2_PACKAGE_PYTHON_CAP1XXX # runtime
	help
	  Display-o-Tron 3000 Driver.

	  http://www.pimoroni.com
```

## package/python-sn3218/Config.in
```kconfig
config BR2_PACKAGE_PYTHON_SN3218
	bool "python-sn3218"
	help
	  A module to drive the sn3218 i2c LED controller.

	  http://www.pimoroni.com
```

## package/python-st7036/Config.in
```kconfig
config BR2_PACKAGE_PYTHON_ST7036
	bool "python-st7036"
	select BR2_PACKAGE_PYTHON_SPIDEV # runtime
	select BR2_PACKAGE_PYTHON_RPIGPIO # runtime
	help
	  Raspberry Pi ST7036 SPI Driver.

	  http://www.pimoroni.com
```
